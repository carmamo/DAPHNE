/**
 ******************************************************************************
 * @file    ICI2022.c
 * @author  Carlos Martinez Mora (carmamo.95@gmail.com)
 * @date	 Nov 10, 2022
 * @brief   short description of the file
 *			...
 *
 ******************************************************************************
 * @attention
 *
 *
 *
 ******************************************************************************
 */
#include "ICI2022.h"
#include <math.h>
#include <string.h>
#include "cmsis_os.h"


/***************************************************************************/
/* CONSTANTS */
/***************************************************************************/

// ' Termometer', 8x56px
const unsigned char Termometer []  = {
		0x00, 0x08, 0x1c, 0x36, 0x22, 0x22, 0xe2, 0x22, 0x62, 0x22, 0x62, 0x22, 0xe2, 0x22, 0x62, 0x22,
		0x62, 0x22, 0xe2, 0x22, 0x62, 0x22, 0x62, 0x22, 0xe2, 0x22, 0x62, 0x22, 0x62, 0x22, 0xe2, 0x22,
		0x62, 0x22, 0x62, 0x22, 0xe2, 0x22, 0x62, 0x22, 0x62, 0x22, 0xe2, 0x22, 0x62, 0x22, 0x62, 0x22,
		0xe2, 0x2a, 0x1c, 0x1c, 0x1c, 0x1c, 0x1c, 0x08
};
// ' Contour_Needle', 8x8px
const unsigned char Contour_Needle []  = {
		0x00, 0x3c, 0x42, 0x42, 0x42, 0x42, 0x3c, 0x00
};
// ' Fill_Cntr_Needle', 8x8px
const unsigned char Fill_Cntr_Needle []  = {
		0x00, 0x3c, 0x7e, 0x7e, 0x7e, 0x7e, 0x3c, 0x00
};
// ' Right_Gauge', 64x56px
const unsigned char Right_Gauge []  = {
		0x00, 0x00, 0x00, 0x00, 0x00, 0x00, 0x00, 0x00, 0x00, 0x00, 0x00, 0x00, 0x00, 0x00, 0x00, 0x00,
		0x00, 0x00, 0x00, 0x00, 0x00, 0x00, 0x00, 0x00, 0x00, 0x00, 0x00, 0x00, 0x00, 0x00, 0x00, 0x00,
		0x00, 0x00, 0x00, 0x07, 0xfe, 0x00, 0x00, 0x00, 0x00, 0x00, 0x00, 0x78, 0x01, 0xe0, 0x00, 0x00,
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		0x00, 0x00, 0x00, 0x00, 0x00, 0x00, 0x00, 0x00, 0x00, 0x00, 0x00, 0x00, 0x00, 0x00, 0x00, 0x00
};
// ' Left_Gauge', 64x56px
const unsigned char Left_Gauge []  = {
		0x00, 0x00, 0x00, 0x00, 0x00, 0x00, 0x00, 0x00, 0x00, 0x00, 0x00, 0x00, 0x00, 0x00, 0x00, 0x00,
		0x00, 0x00, 0x00, 0x00, 0x00, 0x00, 0x00, 0x00, 0x00, 0x00, 0x00, 0x00, 0x00, 0x00, 0x00, 0x00,
		0x00, 0x00, 0x00, 0x7f, 0xe0, 0x00, 0x00, 0x00, 0x00, 0x00, 0x07, 0x80, 0x1e, 0x00, 0x00, 0x00,
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		0x00, 0x00, 0x00, 0x00, 0x00, 0x00, 0x00, 0x00, 0x00, 0x00, 0x00, 0x00, 0x00, 0x00, 0x00, 0x00
};


/***************************************************************************/
/* Pines Bobinas STEPPER */
/***************************************************************************/
const uint16_t pins[4] = {GPIO_PIN_3, GPIO_PIN_5, GPIO_PIN_4, GPIO_PIN_10};
/***************************************************************************/
/* Matriz Estados STEPPER */
/***************************************************************************/
const GPIO_PinState matrix[5][4] = {
		{GPIO_PIN_SET, GPIO_PIN_SET, GPIO_PIN_RESET, GPIO_PIN_RESET},
		{GPIO_PIN_RESET, GPIO_PIN_SET, GPIO_PIN_SET, GPIO_PIN_RESET},
		{GPIO_PIN_RESET, GPIO_PIN_RESET, GPIO_PIN_SET, GPIO_PIN_SET},
		{GPIO_PIN_SET, GPIO_PIN_RESET, GPIO_PIN_RESET, GPIO_PIN_SET},
		{GPIO_PIN_RESET, GPIO_PIN_RESET, GPIO_PIN_RESET, GPIO_PIN_RESET}};
/***************************************************************************/
/* Matriz Estados Medios Pasos STEPPER */
/***************************************************************************/
const GPIO_PinState matrix_half[9][4] = {
		{GPIO_PIN_SET, GPIO_PIN_RESET, GPIO_PIN_RESET, GPIO_PIN_RESET},
		{GPIO_PIN_SET, GPIO_PIN_SET, GPIO_PIN_RESET, GPIO_PIN_RESET},
		{GPIO_PIN_RESET, GPIO_PIN_SET, GPIO_PIN_RESET, GPIO_PIN_RESET},
		{GPIO_PIN_RESET, GPIO_PIN_SET, GPIO_PIN_SET, GPIO_PIN_RESET},
		{GPIO_PIN_RESET, GPIO_PIN_RESET, GPIO_PIN_SET, GPIO_PIN_RESET},
		{GPIO_PIN_RESET, GPIO_PIN_RESET, GPIO_PIN_SET, GPIO_PIN_SET},
		{GPIO_PIN_RESET, GPIO_PIN_RESET, GPIO_PIN_RESET, GPIO_PIN_SET},
		{GPIO_PIN_SET, GPIO_PIN_RESET, GPIO_PIN_RESET, GPIO_PIN_SET},
		{GPIO_PIN_RESET, GPIO_PIN_RESET, GPIO_PIN_RESET, GPIO_PIN_RESET}};

/***************************************************************************/
/* Velocidad en RPM */
/***************************************************************************/
float steps_sec;
float rpm[9];

/***************************************************************************/
/* Device Struct */
/***************************************************************************/
static ICI2022_t dev;

/***************************************************************************/
/* INITIALIZE LIBRARY */
/***************************************************************************/

void ICI2022_Init(I2C_HandleTypeDef *i2cHandle, UART_HandleTypeDef *uartHandle) {

	/* Init Struct */
	dev.i2cHandle = i2cHandle;
	dev.uartHandle = uartHandle;

}

/***************************************************************************/
/* OLED FUNCTIONS */
/***************************************************************************/

// Byte GPIO and Delay Callback
uint8_t u8x8_stm32_gpio_and_delay(u8x8_t *u8x8, uint8_t msg, uint8_t arg_int, void *arg_ptr) {
	switch (msg) {
	case U8X8_MSG_GPIO_AND_DELAY_INIT:
		osDelay(1);
		break;
	case U8X8_MSG_DELAY_MILLI:
		osDelay(arg_int);
		break;
	default:
		u8x8_SetGPIOResult(u8x8, 1);			// default return value
		break;
	}
	return 1;
}

// Communication Callback
uint8_t u8x8_byte_i2c(u8x8_t *u8x8, uint8_t msg, uint8_t arg_int, void *arg_ptr)
{
	static uint8_t buffer[32];		/* u8g2/u8x8 will never send more than 32 bytes between START_TRANSFER and END_TRANSFER */
	static uint8_t buf_idx;
	uint8_t *data;

	switch(msg)
	{
	case U8X8_MSG_BYTE_SEND:
		data = (uint8_t *)arg_ptr;
		while( arg_int > 0 )
		{
			buffer[buf_idx++] = *data;
			data++;
			arg_int--;
		}
		break;
	case U8X8_MSG_BYTE_INIT:
		/* add your custom code to init i2c subsystem */
		break;
	case U8X8_MSG_BYTE_SET_DC:
		/* ignored for i2c */
		break;
	case U8X8_MSG_BYTE_START_TRANSFER:
		buf_idx = 0;
		break;
	case U8X8_MSG_BYTE_END_TRANSFER:
		HAL_I2C_Master_Transmit(dev.i2cHandle, u8x8_GetI2CAddress(u8x8), buffer, buf_idx, 1000);
		break;
	default:
		return 0;
	}
	return 1;
}

/***************************************************************************/
/* LOW-LEVEL STEPPER FUNCTIONS */
/***************************************************************************/

//void step()
//{
//switch(giro_stepper)
//{
//case Horario:
//{
//	for(int i = 0; i < 4; i++)
//	{
//		HAL_GPIO_WritePin(GPIOB, pines[i], matrix_half[ciclo][i]);		// Medios pasos, quitar _half para paso completo
//	}
//	ciclo++;
//	//			if(ciclo > 3) ciclo = 0;											// Pasos completos
//	if(ciclo > 7) ciclo = 0;											// Medios pasos
//	break;
//}
//case Antihorario:
//{
//	for(int i = 0; i < 4; i++)
//	{
//		HAL_GPIO_WritePin(GPIOB, pines[i], matrix_half[ciclo][i]);		// Medios pasos, quitar _half para paso completo
//	}
//	ciclo--;
//	//			if(ciclo < 0) ciclo = 3;											// Pasos completos
//	if(ciclo < 0) ciclo = 7;											// Medios pasos
//	break;
//}
//default:
//{
//	break;
//}
//}
//}

/***************************************************************************/
/* MATH FUNCTIONS */
/***************************************************************************/

uint32_t map(uint32_t IN, uint32_t INmin, uint32_t INmax, uint32_t OUTmin, uint32_t OUTmax)
{
    return ((((IN - INmin)*(OUTmax - OUTmin))/(INmax - INmin)) + OUTmin);
}

void calc_needle(needle *s)
{
	s->end_x = (s->big * -sin(radians(s->angle))) + s->center_x;
	s->end_y = (s->big * cos(radians(s->angle))) + s->center_y;
	s->start_x = (s->small * -sin(radians(s->angle + 180.0))) + s->center_x;
	s->start_y = (s->small * cos(radians(s->angle + 180.0))) + s->center_y;
}

void calc_rpm(void)
{
/*
 * CALCULATE RPM TABLE
 */
for(int i = 2; i < 11; i++)
{
	steps_sec = 1000/(i);									// pf = pulse frequency
	rpm[i-2] = 60*(steps_sec/4096);							// 4096 half steps
}
}

double radians(double degrees)
{
	return degrees * M_PI / 180.0;
}

/***************************************************************************/
/* LOW-LEVEL FUNCTIONS */
/***************************************************************************/

void send_uart(char *string)
{
	HAL_UART_Transmit(dev.uartHandle, (uint8_t *)string, strlen(string), HAL_MAX_DELAY);
}


